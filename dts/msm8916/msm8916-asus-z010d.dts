// SPDX-License-Identifier: GPL-2.0-only

/dts-v1/;

/include/ "skeleton.dtsi"

/ {
	qcom,msm-id = <206 0>;
	qcom,board-id = <0x8 0x0>;
	model = "Asus Zenfone Max ZC550KL";
	compatible = "asus,z010d", "qcom,msm8916", "lk2nd,device";
	lk2nd,match-cmdline= "* mdss_mdp.panel=1:dsi:0:qcom,mdss_dsi_r69339_720p_video:1:none";
};